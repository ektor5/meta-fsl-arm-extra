## conf/machine/A62q_1G.conf
```bitbake
#@TYPE: Machine
#@NAME: A62q_1G
#@SOC: i.MX6Q
#@DESCRIPTION: Machine configuration for A62q 1G
#@MAINTAINER: Ettore Chimenti <ek5.chimenti@gmail.com>

include include/seco_a62.inc

SOC_FAMILY = "mx6:mx6q:a62"

UBOOT_MACHINE = "mx6q_SBC_A62_config"
UBOOT_MAKE_TARGET = "DDR_SIZE=2 DDR_TYPE=1 BOARD_TYPE=A62 CPU_TYPE=QUAD ENV_DEVICE=ENV_MMC "

KERNEL_DEVICETREE = "imx6q-seco_SBC_A62.dtb"
KERNEL_IMAGETYPE = "zImage"
```

## conf/machine/include/seco_a62.inc
```bitbake
# Common settings for seco boards

include conf/machine/include/imx-base.inc
include conf/machine/include/tune-cortexa9.inc

PREFERRED_PROVIDER_virtual/kernel ?= "linux-seco"
PREFERRED_VERSION_linux-seco ?= "3.14.28"
KERNEL_IMAGETYPE = "zImage"

PREFERRED_PROVIDER_u-boot ?= "u-boot-seco"
PREFERRED_VERSION_u-boot = "2014.04"

SERIAL_CONSOLE = "115200 ttymxc1"

MACHINE_FEATURES += " "
```
